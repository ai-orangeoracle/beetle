## sdkconfig.defaults
```kconfig
# beetle (甲壳虫) - Common defaults
# Target-specific: sdkconfig.defaults.esp32s3 / sdkconfig.defaults.esp32c3

# 不用蓝牙时显式关闭，减少链接进固件的组件（若需 BLE 可删此行）
CONFIG_BT_ENABLED=n

# 浏览器请求头（Origin/Accept/User-Agent/Referer/X-Pairing-Code 等）常超默认 512 字节，避免 431
CONFIG_HTTPD_MAX_REQ_HDR_LEN=2048

CONFIG_LWIP_LOCAL_HOSTNAME="beetle"

# 线程默认栈：agent/build_context + JSON 序列化等需要更大栈，避免栈溢出
CONFIG_PTHREAD_TASK_STACK_SIZE_DEFAULT=16384
```

## sdkconfig.defaults.esp32s3
```kconfig
# beetle - ESP32-S3 target
CONFIG_IDF_TARGET="esp32s3"

CONFIG_ESPTOOLPY_FLASHSIZE_16MB=y
CONFIG_ESPTOOLPY_FLASHMODE_QIO=y
CONFIG_ESP_DEFAULT_CPU_FREQ_MHZ_240=y

# PSRAM 8MB Octal；ALWAYSINTERNAL=256 使 >256B 分配走 PSRAM，减轻 internal 压力（WSS+HTTP 双 TLS 需预留 internal）。
CONFIG_SPIRAM=y
CONFIG_SPIRAM_MODE_OCT=y
CONFIG_SPIRAM_SPEED_80M=y
CONFIG_SPIRAM_MALLOC_ALWAYSINTERNAL=256
CONFIG_SPIRAM_MALLOC_RESERVE_INTERNAL=131072
CONFIG_SPIRAM_MEMTEST=n

CONFIG_ESP_WIFI_STATIC_RX_BUFFER_NUM=3
CONFIG_ESP_WIFI_DYNAMIC_RX_BUFFER_NUM=6
CONFIG_ESP_WIFI_RX_BA_WIN=3
CONFIG_LWIP_TCPIP_RECVMBOX_SIZE=16
# WSS + 多路 HTTP（sender/agent/心跳）并发时需更多 socket，避免 esp-tls Failed to create socket
CONFIG_LWIP_MAX_SOCKETS=16

CONFIG_MBEDTLS_EXTERNAL_MEM_ALLOC=y
CONFIG_MBEDTLS_SSL_IN_CONTENT_LEN=16384
CONFIG_MBEDTLS_SSL_OUT_CONTENT_LEN=4096

# 证书包：包含常见根证书，支持百度等 API 的 TLS 验证
CONFIG_MBEDTLS_CERTIFICATE_BUNDLE=y
CONFIG_MBEDTLS_CERTIFICATE_BUNDLE_DEFAULT_FULL=y
# mbedTLS 4.0 (IDF v6.0) 默认不处理交叉签名链；百度/GlobalSign 等 CDN 常返回交叉签名根证书，
# 不启用此选项会导致 "No matching trusted root certificate found"。heap 增量 ~700B，可忽略。
CONFIG_MBEDTLS_CERTIFICATE_BUNDLE_CROSS_SIGNED_VERIFY=y

CONFIG_HTTPD_WS_SUPPORT=y

CONFIG_PARTITION_TABLE_CUSTOM=y
# CMake 工程根目录为 esp-idf-sys 的 out/，相对路径需指向仓库根目录的 partitions.csv（见 IDF partition_table/project_include.cmake）。
CONFIG_PARTITION_TABLE_CUSTOM_FILENAME="../../../../../../partitions.csv"

CONFIG_ESP_CONSOLE_UART_DEFAULT=y
CONFIG_ESP_CONSOLE_SECONDARY_USB_SERIAL_JTAG=y

# main 任务栈：NVS/SPIFFS/WiFi 等初始化链较深，避免栈溢出
CONFIG_ESP_MAIN_TASK_STACK_SIZE=20000

# 任务看门狗超时：单次 LLM 请求+网络延迟可能较长，避免误复位
CONFIG_ESP_TASK_WDT_TIMEOUT_S=60

# ESP-IDF v6.0 内存优化：将 FreeRTOS 函数放到 Flash，节省 10-20KB 内部 RAM
# 禁用：该配置导致 WiFi 重连时栈溢出（v6.0 的 WiFi/TLS 驱动在 Flash 执行时栈使用增加）
# CONFIG_FREERTOS_PLACE_FUNCTIONS_INTO_FLASH is not set
# CONFIG_FREERTOS_PLACE_SNAPSHOT_FUNS_INTO_FLASH is not set
```
